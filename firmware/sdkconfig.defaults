## firmware/sdkconfig.defaults
```kconfig
# ---------------- 目标芯片 / Flash ----------------
CONFIG_IDF_TARGET="esp32s3"
CONFIG_ESPTOOLPY_FLASHSIZE_16MB=y
CONFIG_ESPTOOLPY_FLASHSIZE="16MB"
CONFIG_PARTITION_TABLE_CUSTOM=y
CONFIG_PARTITION_TABLE_CUSTOM_FILENAME="partitions.csv"
CONFIG_PARTITION_TABLE_FILENAME="partitions.csv"

# ---------------- PSRAM (ESP32-S3R8 = 8MB Octal) ----------------
CONFIG_SPIRAM=y
CONFIG_SPIRAM_MODE_OCT=y
CONFIG_SPIRAM_SPEED_80M=y
CONFIG_SPIRAM_FETCH_INSTRUCTIONS=y
CONFIG_SPIRAM_RODATA=y
CONFIG_SPIRAM_USE_MALLOC=y

# ---------------- 性能 ----------------
CONFIG_ESP32S3_DEFAULT_CPU_FREQ_240=y
CONFIG_ESP32S3_DEFAULT_CPU_FREQ_MHZ=240
CONFIG_ESP32S3_DATA_CACHE_LINE_64B=y
CONFIG_ESP32S3_DATA_CACHE_LINE_SIZE=64
CONFIG_COMPILER_OPTIMIZATION_PERF=y
CONFIG_FREERTOS_HZ=1000

# ---------------- 内存 / 栈 ----------------
# Lua 解析器是递归下降，主任务栈给大一点
CONFIG_ESP_MAIN_TASK_STACK_SIZE=20480
CONFIG_ESP_SYSTEM_EVENT_TASK_STACK_SIZE=4096

# ---------------- FATFS ----------------
# 默认是 LFN_NONE：manifest.json 这种长文件名创建会直接 EINVAL。
# 插件目录里全是长文件名，必须开。
CONFIG_FATFS_LFN_HEAP=y
CONFIG_FATFS_MAX_LFN=255

# ---------------- 日志 ----------------
CONFIG_LOG_DEFAULT_LEVEL_INFO=y

# ---------------- 蓝牙关掉，省 Flash / 编译时间 ----------------
CONFIG_BT_ENABLED=n
```
